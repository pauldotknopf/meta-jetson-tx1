## conf/layer.conf
```bitbake
# We have a conf and classes directory, add to BBPATH
BBPATH .= ":${LAYERDIR}"

# We have recipes-* directories, add to BBFILES
BBFILES += "${LAYERDIR}/recipes-*/*/*.bb \
	${LAYERDIR}/recipes-*/*/*.bbappend"

BBFILE_COLLECTIONS += "meta-jetson-tx1"
BBFILE_PATTERN_meta-jetson-tx1 = "^${LAYERDIR}/"
BBFILE_PRIORITY_meta-jetson-tx1 = "6"
```

## conf/machine/jetson-tx1.conf
```bitbake
#@TYPE: Machine
#@NAME: NVidia Jetson TX1
#@DESCRIPTION: NVidia Jetson TX1 board

require conf/machine/include/arm/arch-armv8.inc

OLDEST_KERNEL = "3.10.0"

PREFERRED_PROVIDER_virtual/xserver ?= "xserver-xorg"
PREFERRED_PROVIDER_virtual/kernel ?= "linux-L4T"
PREFERRED_PROVIDER_virtual/mesa ?= "mesa"
PREFERRED_PROVIDER_virtual/libgl ?= "mesa"

SERIAL_CONSOLE = "115200 ttyS0"

XSERVER ?= "xserver-xorg \
            ${@bb.utils.contains('DISTRO_FEATURES', 'opengl', 'mesa-driver-swrast xserver-xorg-extension-glx', '', d)} \
            xf86-input-evdev \
            xf86-input-mouse \
            xf86-video-fbdev \
            xf86-input-keyboard"

KERNEL_IMAGETYPE = "zImage"

MACHINE_ESSENTIAL_EXTRA_RRECOMMENDS += " \
            bootconfig \
            kernel-image \
            kernel-devicetree \
            "

IMAGE_FSTYPES = "tar.bz2"
```
